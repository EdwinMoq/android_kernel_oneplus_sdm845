## drivers/media/platform/msm/vidc/governors/Kconfig
```kconfig
menuconfig MSM_VIDC_LEGACY_GOVERNORS
	tristate "Clock and bandwidth governors for QTI MSM V4L2 based video driver"
	depends on MSM_VIDC_LEGACY_V4L2 && PM_DEVFREQ
	help
	Chooses a set of devfreq governors aimed at providing accurate bandwidth
	or clock frequency values for MSM V4L2 video driver.
```

## drivers/oneplus/drivers/Kconfig
```kconfig
config OEM_DEBUG_SUPPORT
        default n
        bool

config OEM_SYSRQ_X
	default n
	depends on OEM_DEBUG_SUPPORT
	bool "echo x > /proc/sysrq-trigger to get init process stacktrace"

config OEM_TRACE_SUPPORT
	default n
	depends on OEM_DEBUG_SUPPORT
	bool "OEM debug function, enable it will register the device, which under /dev/otracer."

config OEM_FORCE_DUMP
	default n
	bool "OEM force dump function, it will enable goto the force dump"

config PARAM_READ_WRITE
	bool "Param partition read/write support"
	default y
	help
		if you want to read/write the param partition in kernel,
		then you must say Y here.

config DEBUG_PARAM_DUMP
	bool "Param debug support"
	default n
	help
		if you want to dump contents of param partition for debug purpose

config OEM_BOOT_MODE
	bool "OEM boot mode driver"
	default n
	help
		Say y here to enable the boot mode driver

source "drivers/oneplus/drivers/input/fingerprint/Kconfig"
```
